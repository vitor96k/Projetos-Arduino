/*     2
 *     _ 
 * 4  |_| 1
 * 7  |_| 3       // O DO MEIO É O PINO 5;
 *     
 *     6
 * 
 *    
 *   12 11 10 9 (8,4,2,1)
 */

int cont = 0;
int z;
int led = 9;
int botao = 13;
int ler;

int mat2[16][4]{
  
  0,0,0,0,  //0
  1,0,0,0,  //1
  0,1,0,0,  //2
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  1,1,1,1   //F
};

int mat[16][7] = {

  1,1,1,1,0,1,1,  //0
  1,0,1,0,0,0,0,  //1
  1,1,0,0,1,1,1,  //2
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  0,1,0,1,1,0,1   //F
};

void setup() {
  int t; 
  for(t=1;t<=7;t++) pinMode(t,OUTPUT);
  for(t=9;t<=12;t++) pinMode(t,OUTPUT);  
  pinMode(botao,INPUT);
}

void loop() {

  ler = digitalRead(botao);

  if(ler == 0){

  if(cont == 16) cont = 0;

  for(z=1;z<=7;z++){
    digitalWrite(z,mat[cont][z-1]);
  }

  for(z=9;z<=12;z++){
    digitalWrite(z,mat2[cont][z-9]);
  }

  delay(250);

  cont ++;
    
  }else{
    
  }
  

  
  
 

   
  

}
